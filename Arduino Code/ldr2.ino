/***************************************************************************************/
/***************************************************************************************/
/***************************************************************************************/
/***************************************************************************************/

int ledArray[] = {13,12,11};

/***************************************************************************************/
boolean balanceSet = false;

/***************************************************************************************/
int red = 0;
int green = 0;
int blue = 0;

/***************************************************************************************/
float colourArray[] = {0,0,0};
float whiteArray[] = {0,0,0};
float blackArray[] = {0,0,0};
/***************************************************************************************/


int avgRead;
/***************************************************************************************/
void setup(){
/***************************************************************************************//***************************************************************************************/ 
/***************************************************************************************//***************************************************************************************/  
  pinMode(13,OUTPUT);
  pinMode(12,OUTPUT);
  pinMode(11,OUTPUT);
 /***************************************************************************************//***************************************************************************************//***************************************************************************************/
 /***************************************************************************************//***************************************************************************************//***************************************************************************************/
  Serial.begin(9600);
 /***************************************************************************************//***************************************************************************************//***************************************************************************************//***************************************************************************************//***************************************************************************************//***************************************************************************************/
}
/***************************************************************************************//***************************************************************************************/
void loop(){

    checkBalance();
    checkColour();
    printColour();
    }
/***************************************************************************************//***************************************************************************************/
void checkBalance(){
  
  if(balanceSet == false){
    setBalance();
  }
}
/***************************************************************************************//***************************************************************************************/
void setBalance(){
 
  
      digitalWrite(13,HIGH);
      delay(100);
      digitalWrite(13,LOW);
      delay(100);
      digitalWrite(13,HIGH);
      delay(100);
      digitalWrite(13,LOW);
      delay(100);
      digitalWrite(13,HIGH);
      delay(100);
      digitalWrite(13,LOW);
      
      delay(5000);

/***************************************************************************************//***************************************************************************************/
  
  for(int i = 0;i<=2;i++){
     digitalWrite(ledArray[i],HIGH);
     delay(200);
     getReading(5);        
     whiteArray[i] = avgRead;
     digitalWrite(ledArray[i],LOW);
     delay(100);
  }
 /***************************************************************************************//***************************************************************************************/ 
  delay(5000);
/***************************************************************************************//***************************************************************************************/

      digitalWrite(11,HIGH);
      delay(100);
      digitalWrite(11,LOW);
      delay(100);
      digitalWrite(11,HIGH);
      delay(100);
      digitalWrite(11,LOW);
      delay(100);
      digitalWrite(11,HIGH);
      delay(100);
      digitalWrite(11,LOW);
/***************************************************************************************//***************************************************************************************/     
      delay(5000);             
/***************************************************************************************//***************************************************************************************/ 
  for(int i = 0;i<=2;i++){
     digitalWrite(ledArray[i],HIGH);
     delay(200);
     getReading(5);
     blackArray[i] = avgRead;
    
     digitalWrite(ledArray[i],LOW);
     delay(100);
  }
  
  balanceSet = true;
 
  delay(5000);
  }
/***************************************************************************************//***************************************************************************************/
void checkColour(){
    for(int i = 0;i<=2;i++){
     digitalWrite(ledArray[i],HIGH);  
     delay(200);                      
     getReading(5);                 
     colourArray[i] = avgRead;        
     float greyDiff = whiteArray[i] - blackArray[i];                   
     colourArray[i] = (colourArray[i] - blackArray[i])/(greyDiff)*255;
     digitalWrite(ledArray[i],LOW);   
     delay(100);
  }
}
/***************************************************************************************//***************************************************************************************/
void getReading(int times){
  int reading;
  int tally=0;
/***************************************************************************************//***************************************************************************************/
for(int i = 0;i < times;i++){
   reading = analogRead(0);
   tally = reading + tally;
   delay(10);
}
/***************************************************************************************//***************************************************************************************/
avgRead = (tally)/times;
}
/***************************************************************************************//***************************************************************************************/
//prints the colour in the colour array
void printColour(){
Serial.print("R = ");
if(colourArray[0]<255)
Serial.println(int((255-(colourArray[0]))));
else 
Serial.println(int(((colourArray[0])-255)));
/***************************************************************************************//***************************************************************************************/

Serial.print("G = ");
if(colourArray[1]<255)
Serial.println(int((255-(colourArray[1]))));
else 
Serial.println(int(((colourArray[1])-255)));
/***************************************************************************************//***************************************************************************************/

Serial.print("B = ");
if(colourArray[2]<255)
Serial.println(int((255-(colourArray[2]))));
else 
Serial.println(int(((colourArray[2])-255)));

if ( colourArray[2]
digitalWrite(7,HIGH);
/***************************************************************************************//***************************************************************************************/
delay(2000);
}
/* BEFORE PRINTING TAKE SAMPLE OF YOUR COLOUR CARDS AND NAME THEM ACCORDINGLY*/



/*
    SYED NOOR ALI JAFRI
         REDLABZ
      0341-2248758
*/  
  
